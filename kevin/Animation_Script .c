
// this ver used in final, U1 POV

// THIS VER IS THE ONE  THAT WORKS BEST NOW keep SAFE...........

#include <fix_fft.h>

char rc;
char endMarker = '\n' ;// clear buffer from TTY and Telco


int inPin = 0;
int val2 = 0;
boolean povRunning1 = false;
boolean povRunning2 = false;
boolean newData = false;

int offsetValue = -20;
const byte numChars = 32;
const int BUFFER_LENGTH2 = 60;
const int BUFFER_LENGTH = 64;
const int R_IN = A1;// fft
const int HomeSw = 2;
const int NUM_HORIZONTAL_POSITIONS = BUFFER_LENGTH / 2;
const int NUM_LED_HOLD_POSITIONS = 10;// was 8
const int Status_led = 12;
const int homeLed = 13;
const int DiagLed = 14;
const int time1 = 600;// use for larg spectrum determins how "wide" the display is
const int time2 = 0; // use for small spectrum determins how "wide" the display is

char Rdata[BUFFER_LENGTH];// fft
char Rim[BUFFER_LENGTH];// fft
char data_avgs[BUFFER_LENGTH / 2];
char textString[] = ".      Waiting for SERIAL     .  ";
char receivedChars[numChars];
char buffer[BUFFER_LENGTH2];

int time0 = 0;// use for spectrum temp holder
int LED_PINS[] = {10, 3, 4, 5, 6, 7, 8, 9};// led order
int length = 75;

String mydata;

const unsigned char font[][6] = {
  {0x00, 0x00, 0x00, 0x00, 0x00, 0x00}, //   0x20 0
  {0x00, 0x00, 0x00, 0x00, 0x00, 0x00}, //   0x20 1
  {0x00, 0x00, 0x00, 0x00, 0x00, 0x00}, //   0x20 2
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  {0x04, 0x02, 0x04, 0x08, 0x04, 0x00}, // ~ 0x7e 126
};


void setup() {
  Serial.begin(9600);
  pinMode(Status_led, OUTPUT);
  pinMode(homeLed, OUTPUT);
  pinMode(DiagLed, OUTPUT);
  digitalWrite(DiagLed, HIGH);
  pinMode(HomeSw, INPUT);

  pinMode(3, OUTPUT);
  pinMode(4, OUTPUT);
  pinMode(5, OUTPUT);
  pinMode(6, OUTPUT);
  pinMode(7, OUTPUT);
  pinMode(8, OUTPUT);
  pinMode(9, OUTPUT);
  pinMode(10, OUTPUT);
  pinMode(12, OUTPUT); // Set pin 12 as output
 

  // Flash LED D12 three(k) times
  for (int i = 0; i < 3000; i++) {
    digitalWrite(12, HIGH); // Turn on LED
    delayMicroseconds(100);
    digitalWrite(12, LOW); // Turn off LED
    delayMicroseconds(300);

  }

  digitalWrite(DiagLed, HIGH); // Turn OFF LED i/o 14
  // Set up initial message
  //------------------------------------------------------------------------------------------------------------------------------------------------------------
  mydata = "                                                           Booting UP ~~~~~ Tachyscope LASER POV ,   NVictria technology  V2.0, 9600 baud              "; // 60 spaces LASER
  //-------------------------------------------------------------------------------------------------------------------------------------------------------------
  leds_display(); // Display message once upon boot-up
}

void loop() {
  recvWithEndMarker();
  if (povRunning1 && !povRunning2) {
    Spectrum1(); // large
  }
  else if (povRunning2 && !povRunning1) {
    Spectrum2(); // small
  }
  else {
    loop2(); // for SW3 to SW9 POV +++++++++ TRIGGER
  }
}

void recvWithEndMarker() {
  static byte ndx = 0;
  const char endMarker = '\n'; // Change to const
  char rc;

  while (Serial.available() > 0) {
    rc = Serial.read();
    if (rc != endMarker) {
      if (ndx < numChars - 1) {
        receivedChars[ndx++] = rc;
      }
    } else {
      receivedChars[ndx] = '\0'; // terminate the string
      parseData();
      ndx = 0;
      newData = true;
      return; // Exit the function after processing one message
    }
  }
}


// scrolling routine at bootup
void leds_display()// original keep
{
  int temp = mydata.length();
  while (temp != 0)
  {
    rotateFrame();
    temp--;
    HOMEsw();
  }
  for (int i = sizeof(textString) - 1; i >= 0; i--) {
    String1();
  }
}


void Spectrum1() {// sw 1= large spectrum
  readAudioData();
  processData();
  updateLEDs();// large spectrum spacing
  ClearDisplay();
}

void Spectrum2() {// sw2 = small spectrum
  readAudioData();
  processData();
  //updateLEDs();
  updateLEDsSW3();// put spaces between bins, small spectrum spacing
  ClearDisplay();
}
void loop2() {
  showNewData();
}

void readAudioData() {
  
  while (digitalRead(HomeSw) != 0);// was 0
  for (int i = 0; i < BUFFER_LENGTH ; i++) {
   Rdata[i] = ((analogRead(R_IN) / 8) - 128);// nice
  }
  fix_fft(Rdata, Rim, 6, 0);// original
}

void processData() {// now both process and mirror as 1 routine
  // First, process the data.
  for (int i = 0; i < NUM_HORIZONTAL_POSITIONS; i++) {
    data_avgs[i] = sqrt(Rdata[i] * Rdata[i] + Rim[i] * Rim[i]);
  }
  // Then, mirror the data.
  for (int i = 0; i < NUM_HORIZONTAL_POSITIONS / 2; i++) {
    char temp = data_avgs[i];
    data_avgs[i] = data_avgs[NUM_HORIZONTAL_POSITIONS - i - 1];
    data_avgs[NUM_HORIZONTAL_POSITIONS - i - 1] = temp;
  }
}
// below for small spectrum
void updateLEDsSW3() {// this ver puts space between bar graphs
  for (int pos = 0; pos < NUM_HORIZONTAL_POSITIONS -1; pos++) {// original (-1) removes leftside index
    int peakValue = static_cast<int>(data_avgs[pos]);
    for (int i = 0; i < NUM_LED_HOLD_POSITIONS; i++) { // original
      digitalWrite(LED_PINS[i], peakValue > 9 - i); // flips display top to bottom (9 leds) POV drop the bottom led so that no leds ON when no audio
      digitalWrite(12, HIGH);// blue led at bottom
    }
    // Space between segments
    delayMicroseconds(100); // Adjust this value to increase/decrease space
    // 200 is good
    // Turn off the LEDs to create the space effect
    for (int i = 0; i < NUM_LED_HOLD_POSITIONS; i++) {
      digitalWrite(LED_PINS[i], LOW);
      digitalWrite(12, LOW);
    }
    // Delay before moving to the next position
    delayMicroseconds(time0);
  }
}


void updateLEDs() {// keep original spectrum LARGE
  for (int pos = 0; pos < NUM_HORIZONTAL_POSITIONS - 1 ; pos++) {
    int peakValue = static_cast<int>(data_avgs[pos]);
    {
      for (int i = 0 ; i < NUM_LED_HOLD_POSITIONS  ; i++) { // original
        digitalWrite(LED_PINS[i], peakValue > 9 - i); // flips display top to bottom
        digitalWrite(12, HIGH);// blue led at bottom
        digitalWrite(12, HIGH);// x 3 for length of ON time
        digitalWrite(12, HIGH);
      }
    }
    delayMicroseconds(time0);
    digitalWrite(12, LOW);
  }
}

void parseData() {// ( space Sw1) to activate spectrum// keep
  char messageFromPC[numChars]; // variable to hold the message from PC
  char numberFromPC[numChars];  // variable to hold the number from PC

  char *strtokIndx; // this is used by strtok() as an index
  char tempChars[numChars]; // temporary array to hold received data

  strcpy(tempChars, receivedChars);
  strtokIndx = strtok(tempChars, ",");     // get the first part - the string
  strcpy(messageFromPC, strtokIndx); // copy it to messageFromPC
  strtokIndx = strtok(NULL, ","); // this continues where the previous call left off
  if (strtokIndx != NULL) {
    strcpy(numberFromPC, strtokIndx);     // convert this part to an integer
  }

  if (strcmp(messageFromPC, " Sw1") == 0) { // Check if the message is " Space Sw1"
    povRunning1 = true; // Activate Spectrum Large routine
    povRunning2 = false; // De-Activate Spectrum smallroutine
  } else if (strncmp(messageFromPC, " Sw", 3) == 0) { // Check if the message starts with " Sw"
    int num = 0;
    if (sscanf(messageFromPC, " Sw%d", &num) == 1) { // Extract the number after " Sw"
      if (num == 1) { // Check if the parsed number is equal to 1
        povRunning1 = true; // Activate Spectrum Large routine
        povRunning2 = false; // De-Activate Spectrum smallroutine
        time0 = time1;// large display
      }
      if (num == 2) { // Check if the parsed number is equal to 1
        povRunning1 = false; // Activate Spectrum Large routine
        povRunning2 = true; // De-Activate Spectrum smallroutine
        time0 = time2;// small display
      }
      else if (num > 2) { // Check if the parsed number larger than 2
        povRunning1 = false; // Activate Spectrum Large routine
        povRunning2 = false; // De-Activate Spectrum smallroutine
         offsetValue = -35;// use for Sw3-Sw10, move to center right
      }
    }
  }
  // If both routines are false, pass the serial over to the POV
  if (!povRunning1 && !povRunning2) {
    // Code to pass serial data over to the POV
    // For example:
    //Serial.print("Passing serial data over to the POV: ");
    // Serial.println(receivedChars);
    // loop2();// run sw3 to 10 POV
    // return; // Exit the function after processing one message
  }
}


void rotateFrame()
{
  char temp = mydata[0];
  for (int i = 0; i < mydata.length() - 1; i++) {
    mydata[i] = mydata[i + 1];
  }
  mydata[mydata.length() - 1] = temp;
}


void HOMEsw()
{
  while (digitalRead(HomeSw) != 0);// laser was 0
    for (int y = length + offsetValue; y > -1; y--)// offset= how far to shift text to center, -20 or -35
  {
    printLetter(mydata[y]);
  }
  // Turn off LEDs representing preceding characters
  for (int i = 0; i < 20; i++) {
    // Turn off each LED column
    for (int row = 0; row < 8; row++) {
      digitalWrite(LED_PINS[row], LOW);
    }
    delayMicroseconds(8); // Adjust if needed
  }
}

void String1()// Static message 1
{
  for (int y = sizeof(textString) + 3; y >= -1; y--) // WHITE +3 shift text to center of POV, 3 spots ***
  {
    printLetter(textString[y]);
  }
  while (digitalRead(HomeSw) != 0);// Laser was 0
}


void ClearDisplay() {
  for (int i = 0; i < NUM_LED_HOLD_POSITIONS; i++) {
    digitalWrite(LED_PINS[i], LOW);
  }
}


void showNewData() { 
  HOMEsw();
  if (newData == true)
  {
    mydata = receivedChars;
    newData = false;
  }
}

void printLetter(char data){ 
  for (int x = 5; x >= 0; x--)
  {
    char temp_data = font[data][x];
    for (int row = 0; row < 8; row++)
    {
      digitalWrite(LED_PINS[row], bitRead(temp_data, row));
      digitalWrite(12, HIGH);// blue led at bottom
    }
    delayMicroseconds(55); // space between char
    digitalWrite(12, LOW);// blue led at bottom
  }
  led1();
}


void led1() {// serial GREEN led5
  val2 = digitalRead(inPin);   // read the RX serial input, copy RX in to led5
  digitalWrite(DiagLed, val2);  // set led on/off to Hi/Low of serial
  digitalWrite(DiagLed, val2);  // set led  a second time to make brighter
}
